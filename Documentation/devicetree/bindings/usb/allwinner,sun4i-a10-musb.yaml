## Documentation/devicetree/bindings/usb/allwinner,sun4i-a10-musb.yaml
```yaml
# SPDX-License-Identifier: GPL-2.0
%YAML 1.2
---
$id: http://devicetree.org/schemas/usb/allwinner,sun4i-a10-musb.yaml#
$schema: http://devicetree.org/meta-schemas/core.yaml#

title: Allwinner A10 mUSB OTG Controller

maintainers:
  - Chen-Yu Tsai <wens@csie.org>
  - Maxime Ripard <mripard@kernel.org>

properties:
  compatible:
    oneOf:
      - enum:
          - allwinner,sun4i-a10-musb
          - allwinner,sun6i-a31-musb
          - allwinner,sun8i-a33-musb
          - allwinner,sun8i-h3-musb
          - allwinner,suniv-f1c100s-musb
      - items:
          - enum:
              - allwinner,sun8i-a83t-musb
              - allwinner,sun20i-d1-musb
              - allwinner,sun50i-a64-musb
              - allwinner,sun50i-a100-musb
              - allwinner,sun50i-h6-musb
              - allwinner,sun55i-a523-musb
          - const: allwinner,sun8i-a33-musb
      - items:
          - const: allwinner,sun50i-h616-musb
          - const: allwinner,sun8i-h3-musb
      - items:
          - const: allwinner,sun5i-a13-musb
          - const: allwinner,sun4i-a10-musb

  reg:
    minItems: 1
    items:
      - description: MUSB core registers
      - description: Allwinner USB-OTG internal DMA registers

  reg-names:
    minItems: 1
    items:
      - const: mc
      - const: dma

  interrupts:
    maxItems: 1

  interrupt-names:
    const: mc

  dmas:
    maxItems: 1
    description: SoC DMA engine channel used for both directions

  dma-names:
    const: rxtx

  clocks:
    maxItems: 1

  resets:
    maxItems: 1

  phys:
    maxItems: 1

  phy-names:
    const: usb

  extcon:
    description: Extcon specifier for the OTG PHY

  dr_mode:
    enum:
      - host
      - otg
      - peripheral

  allwinner,sram:
    description: Phandle to the device SRAM
    $ref: /schemas/types.yaml#/definitions/phandle-array

required:
  - compatible
  - reg
  - interrupts
  - interrupt-names
  - clocks
  - phys
  - phy-names
  - dr_mode
  - extcon

allOf:
  - if:
      properties:
        compatible:
          contains:
            enum:
              - allwinner,sun6i-a31-musb
              - allwinner,sun8i-a33-musb
              - allwinner,sun8i-h3-musb
    then:
      required:
        - resets

  # Only the A83T, H3 (and its H5 twin) and A64 have the vendor "internal
  # DMA" engine, and hence a second register region.
  - if:
      not:
        properties:
          compatible:
            contains:
              enum:
                - allwinner,sun8i-a83t-musb
                - allwinner,sun8i-h3-musb
                - allwinner,sun50i-a64-musb
    then:
      properties:
        reg:
          maxItems: 1
        reg-names:
          maxItems: 1

  # Only SoCs whose controller has no DMA engine of its own (A13) use a
  # channel of the SoC DMA engine.
  - if:
      not:
        properties:
          compatible:
            contains:
              const: allwinner,sun5i-a13-musb
    then:
      properties:
        dmas: false
        dma-names: false

additionalProperties: false

examples:
  - |
    usb_otg: usb@1c13000 {
      compatible = "allwinner,sun4i-a10-musb";
      reg = <0x01c13000 0x0400>;
      clocks = <&ahb_gates 0>;
      interrupts = <38>;
      interrupt-names = "mc";
      phys = <&usbphy 0>;
      phy-names = "usb";
      extcon = <&usbphy 0>;
      dr_mode = "peripheral";
    };

...
```

## drivers/crypto/allwinner/sunxi-ce/Kconfig
```kconfig
# SPDX-License-Identifier: GPL-2.0-only
config CRYPTO_DEV_SUNXI_CE
	tristate "Allwinner Crypto Engine (CE V5) accelerator"
	depends on ARCH_SUNXI || COMPILE_TEST
	select CRYPTO_SKCIPHER
	select CRYPTO_HASH
	select CRYPTO_ENGINE
	select HW_RANDOM
	default m
	help
	  Driver for Allwinner Crypto Engine (CE V5 architecture) found on
	  Allwinner A733 / sun60iw2 and A523 / sun55i SoCs.
	  Supports hardware acceleration for AES (CBC, ECB, CTR, CTS, XTS,
	  OFB, CFB, GCM), DES, 3DES, MD5, SHA-1, SHA-224, SHA-256, SHA-384,
	  SHA-512, HMAC, PRNG, and True Random Number Generator (TRNG) exposed
	  via /dev/hwrng.
```

## drivers/soc/sunxi/vipcore/Kconfig
```kconfig
# SPDX-License-Identifier: GPL-2.0-only
config ALLWINNER_VIPCORE
	tristate "Allwinner VIP9000 NPU Core Driver"
	depends on ARCH_SUNXI
	help
	  Enable support for the VeriSilicon VIP9000 Neural Processing Unit (NPU)
	  found in Allwinner A733 / sun60iw2 SoCs.
```
